/* AR8030 BB register defaults, shared across all board variants.
 * Extracted from the 18.21.10 firmware decompile (bb_phy_basic_init).
 * Chip variant 1, bit9 set. Values at 0xb54 and 0xb70 assumed 0
 * (sub-version != 0). Needs verification from a live register dump.
 * Reverse engineered from the stock firmware. */

static const uint8_t defaults[5632] = {
    0x00, 0x00, 0x00, 0x00, 0x7c, 0x00, 0x01, 0x18,  /* [  0] BB+0x000 = 0x1801007c */
    0x04, 0x00, 0x00, 0x00, 0x00, 0x00, 0x00, 0x00,  /* [  1] BB+0x004 = 0x00000000 */
    0x08, 0x00, 0x00, 0x00, 0x02, 0x0e, 0x00, 0x80,  /* [  2] BB+0x008 = 0x80000e02 */
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    0xfc, 0x0d, 0x00, 0x00, 0x00, 0x00, 0x00, 0x00,  /* [703] BB+0xdfc = 0x00000000 */
};
