## boards/artosyn/ar8030_bringup/Kconfig.ar8030_bringup
```kconfig
# SPDX-License-Identifier: MIT
config BOARD_AR8030_BRINGUP
	select SOC_AR8030_BRINGUP
```

## boards/artosyn/ar8030_bringup/ar8030_bringup_defconfig
```kconfig
# SPDX-License-Identifier: MIT
CONFIG_XIP=n
CONFIG_MULTITHREADING=n
CONFIG_SYS_CLOCK_EXISTS=n
CONFIG_RISCV_PMP=n
CONFIG_SERIAL=y
```

## boards/artosyn/ar8030_bringup/board.yml
```yaml
board:
  name: ar8030_bringup
  full_name: AR8030 experimental polling bring-up
  vendor: artosyn
  socs:
    - name: ar8030_bringup
```

## soc/artosyn/ar8030_bringup/Kconfig
```kconfig
# SPDX-License-Identifier: MIT
config SOC_AR8030_BRINGUP
	select RISCV
	select RISCV_PRIVILEGED
	select RISCV_ISA_RV32I
	select RISCV_ISA_EXT_M
	select RISCV_ISA_EXT_C
	select RISCV_ISA_EXT_ZICSR
	select RISCV_ISA_EXT_ZIFENCEI
	select INCLUDE_RESET_VECTOR
	select RISCV_SOC_HAS_GP_RELATIVE_ADDRESSING
```

## soc/artosyn/ar8030_bringup/Kconfig.soc
```kconfig
# SPDX-License-Identifier: MIT
config SOC_AR8030_BRINGUP
	bool

config SOC
	default "ar8030_bringup" if SOC_AR8030_BRINGUP
```
